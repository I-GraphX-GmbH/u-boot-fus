/ {
	mcu_rdc {
		compatible = "imx8m,mcu_rdc";
			    /* rdc config when MCU starts
			     * master
			     *   SDMA1p --> domain 1
			     *   SDMA1b --> domain 1
			     * peripheral:
			     *   RDC    --> Domain 0 and 1 can access
			     *   UART1  --> Only Domain 1 can access
			     *   GPT1   --> Only Domain 1 can access
			     *   SDMA1  --> Only Domain 1 can access
			     *   WDOG3  --> Only Domain 1 can access
			     *   PWM3   --> Only Domain 1 can access
			     * memory:
			     *   TCM    --> Only Domain 1 can access (0x7E0000~0x81FFFF)
			     *   DDR    --> Only Domain 1 can access (0x80000000~0x81000000)
			     * end.
			     */

		start-config = <
				RDC_PDAP RDC_PDAP_RDC   0xF 0x0 0x0
			    RDC_MDA  RDC_MDA_SDMA1p DID1 0x0 0x0
			    RDC_MDA  RDC_MDA_SDMA1b DID1 0x0 0x0
				RDC_PDAP RDC_PDAP_SDMA1 PDAP_D1_ACCESS 0x0 0x0
			    RDC_PDAP RDC_PDAP_UART1 PDAP_D1_ACCESS 0x0 0x0
				RDC_PDAP RDC_PDAP_GPT1  PDAP_D1_ACCESS 0x0 0x0
				RDC_PDAP RDC_PDAP_WDOG3 PDAP_D1_ACCESS 0x0 0x0
				RDC_PDAP RDC_PDAP_PWM3 PDAP_D1_ACCESS 0x0 0x0
			    RDC_MEM_REGION 22 TCM_START TCM_END MEM_D1_ACCESS
			    RDC_MEM_REGION 39 M4_DDR_START M4_DDR_END MEM_D1_ACCESS
			    0x0      0x0            0x0  0x0 0x0
			  >;
			    /* rdc config when MCU stops
			     * memory:
			     *   TCM    --> domain 0/1 can access (0x7E0000~0x81FFFF)
			     *   DDR    --> domain 0/1 can access (0x80000000~0x81000000)
			     * end.
			     */
		stop-config = <
			    RDC_MEM_REGION 22 TCM_START TCM_END MEM_D0D1_ACCESS
			    RDC_MEM_REGION 39 M4_DDR_START M4_DDR_END MEM_D0D1_ACCESS
			    0x0      0x0            0x0  0x0 0x0
			  >;
	};
};

