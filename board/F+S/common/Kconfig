## board/F+S/common/Kconfig
```kconfig
if TARGET_FSVYBRID || TARGET_FSIMX6 || TARGET_FSIMX6SX || TARGET_FSIMX6UL || TARGET_FSIMX7ULP || TARGET_FSIMX8M || TARGET_FSIMX8MM || TARGET_FSIMX8MN || TARGET_FSIMX8MP || TARGET_FSIMX8X

config ETHADDR_BASE
	string
	default "00:05:51:07:55:83"

config ADDFSHEADER
	bool
	default y

config FS_NBOOT_ARGS
	bool

config FS_BOARD_CFG
	bool

config FS_BOARD_COMMON
	bool
	default y

config FS_BOARD_MODE_RO
	bool "Load rootfs read-only (F&S)"
	default y
	help
	  F&S boards usually start the rootfs in read-only mode to
	  avoid any data loss when the power fails or when the board is
	  simply switched off without a proper shutdown procedure. If
	  you want a writable rootfs instead, say N here. But be warned,
	  this may be dangerous for your data!

config FS_IMAGE_COMMON
	bool
	default y if TARGET_FSIMX8MM || TARGET_FSIMX8MN || TARGET_FSIMX8MP || TARGET_FSIMX8X

config FS_DRAM_COMMON
	bool
	default y if TARGET_FSIMX8MM || TARGET_FSIMX8MN || TARGET_FSIMX8MP || TARGET_FSIMX8X

config FS_FDT_COMMON
	bool
	default y

config FS_MMC_COMMON
	bool
	default y if TARGET_FSIMX6 || TARGET_FSIMX6SX || TARGET_FSIMX6UL || TARGET_FSIMX7ULP || TARGET_FSIMX8MM || TARGET_FSIMX8MN || TARGET_FSIMX8MP

config FS_ETH_COMMON
	bool
	default y if TARGET_FSIMX6 || TARGET_FSIMX6SX || TARGET_FSIMX6UL || TARGET_FSIMX8MM || TARGET_FSIMX8MN || TARGET_FSIMX8MP || TARGET_FSIMX8X

config FS_USB_COMMON
	bool
	default y if TARGET_FSIMX6 || TARGET_FSIMX6SX || TARGET_FSIMX6UL

config FS_USB_PWR_USBNC
	bool "Use USB PWR function from host controller"
	depends on FS_USB_COMMON
	default y
	help
	  The VBUS power for a USB host port can either be switched
	  automatically in hardware by the dedicated USB controller
	  function or manually by setting the pad as a GPIO. If you
	  say N, the code will use the GPIO variant, if you say Y,
	  the dedicated controller function will be used where possible.

config FS_SPL_MEMTEST_COMMON
	bool "Activate memory test in SPL"
	depends on TARGET_FSIMX8MP || TARGET_FSIMX8MM
	select SPL_CACHE_SUPPORT
	select LIB_RAND
	select SPL_ALLOC_BD
	default n
	help
        Run a DRAM test in SPL. The board will have to be resettet after
        the test.

config FS_SELFTEST
	bool "Activate F&S U-boot selftest"
	depends on TARGET_FSIMX8MP || TARGET_FSIMX8MM || TARGET_FSIMX8MN
	default n
	help
        Runs a quick DRAM test and checks the CPU type. Writes the result to bdinfo.
		The DRAM test will write values all over the memory, so only use this, if you
		are sure, that nothing will get coruppted!
		Also sets the bootdely and all update checks to 0, so the U-boot can start as
		quick as possible

config FS_DISP_COMMON
	bool
	default y if TARGET_FSIMX6 || TARGET_FSIMX6SX || TARGET_FSIMX6UL

config FS_DISP_COUNT
	int
	depends on FS_DISP_COMMON
	default 4 if TARGET_FSIMX6
	default 2 if TARGET_FSIMX6SX
	default 1 if TARGET_FSIMX6UL

config USB_TCPC
	bool "USB Typec port controller simple driver"
	default n if TARGET_FSIMX8MP
	help
	  Enable USB type-c port controller (TCPC) driver

endif
```
