/*
 * Copyright (C) 2022 F&S Elektronik Systeme GmbH
 *
 * This program is free software; you can redistribute it and/or modify
 * it under the terms of the GNU General Public License version 2 as
 * published by the Free Software Foundation.
 */

/dts-v1/;

#include "nboot-info.dtsi"

/ {
	board-cfg {
		board-name = "armStoneMX8MP";

		/* DRAM: 2GB Samsung B.ICDRAM.30 */
		dram-type = "lpddr4";
		dram-timing = "lpddr4_as_2g1600m2ch1cs";
		dram-size = <0x800>;		/* In MiB */
		dram-chips = <1>;

		/* Boot-Device: NAND | MMC1/2/3 | SD1/2/3 */
		boot-dev = "MMC1";

		/* Fuse settings, fuse-bankword: MSW: Bank, LSW: Fuse-Word */
		fuse-bankword = <0x00010003>;
		fuse-mask =     <0x1000fe00>;
		fuse-value =    <0x10002a00>;

		/* Common board features */
		//have-nand;
		have-emmc;
		have-audio;
		have-eth-phy-a;
		have-eth-phy-b;
		//have-wlan;
		//have-mipi-dsi;
		//have-hdmi;
		have-ext-rtc;
		have-security;
		have-adc;
		have-can0;
		//have-can1;
		//have-rs485;

		/* Board-revision specific features */
		armStoneMX8MP-FERT7.100 {
			board-rev = <100>;
		};

		armStoneMX8MP-FERT7.110 {
			board-rev = <110>;
			have-eeprom;
		};
	};
};
